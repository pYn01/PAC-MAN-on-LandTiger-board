#include "table.h"
#include "GLCD.h"
#include <stdio.h>
#include <stdlib.h>
#include "pacman.h"

int N_righe = 31;
int N_colonne = 28;
int N_celle = 31 * 28;
int Pills = 0;
int Power_Pills=6;
int pixel_gap = 8;

#include <stdio.h>



// Matrice globale 31x28
int Griglia[31][28] = {
    {1, 1, 1, 1, 1, 1, 1, 1, 1, 1, 1, 1, 1, 1, 1, 1, 1, 1, 1, 1, 1, 1, 1, 1, 1, 1, 1, 1},
    {1, 0, 0, 0, 0, 0, 0, 0, 0, 0, 0, 0, 0, 1, 1, 0, 0, 0, 0, 0, 0, 0, 0, 0, 0, 0, 0, 1},
    {1, 0, 1, 1, 1, 1, 0, 1, 1, 1, 1, 1, 0, 1, 1, 0, 1, 1, 1, 1, 1, 0, 1, 1, 1, 1, 0, 1},
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		{1, 1, 1, 1, 1, 1, 1, 1, 1, 1, 1, 1, 1, 1, 1, 1, 1, 1, 1, 1, 1, 1, 1, 1, 1, 1, 1, 1},
		};

	// 240 X 320
	// 224 X 248 labirinto
	// 8 pixel cella
		
	/* 8 36          232 36
		
		 8 284         232 284*/
		
		
void Draw_table(){

	int i,j;
	for(i=0; i<N_righe; i++){
		for(j=0; j<N_colonne; j++){
			if(Griglia[i][j] == 1){
				LCD_DrawLine(8+j*8, 36+i*8, 16+j*8, 36+i*8, Blue);
				LCD_DrawLine(8+j*8, 36+i*8, 8+j*8, 36+8+i*8, Blue);
				LCD_DrawLine(16+j*8, 36+i*8, 16+j*8, 36+8+i*8, Blue);
				LCD_DrawLine(8+j*8, 36+8+i*8, 16+j*8, 36+8+i*8, Blue);
			}
			if(Griglia[i][j] == 0){
				Pills=Pills+1;
				LCD_SetPoint(8+4+j*8, 36+4+i*8, Green);
				LCD_SetPoint(8+5+j*8, 36+4+i*8, Green);
				LCD_SetPoint(8+4+j*8, 36+5+i*8, Green);
				LCD_SetPoint(8+5+j*8, 36+5+i*8, Green);
			}
		}
	}
}

void Power_pills(int tot){
	int i, j;
	
	tot=tot % N_celle;
	
	j = tot % N_colonne;
	i = tot / N_colonne;
	
  if (Griglia[i][j] == 0) {
		
			Griglia[i][j]=50;
				
			LCD_DrawLine(1+8+j*8, 36+3+i*8, 16-1+j*8, 36+3+i*8, Cyan);
			LCD_DrawLine(1+8+j*8, 36+4+i*8, 16-1+j*8, 36+4+i*8, Cyan);
			LCD_DrawLine(1+8+j*8, 36+5+i*8, 16-1+j*8, 36+5+i*8, Cyan);

	
			LCD_DrawLine(8+3+j*8, 1+36+i*8, 8+3+j*8, 36+7+i*8, Cyan);
			LCD_DrawLine(8+4+j*8, 1+36+i*8, 8+4+j*8, 36+7+i*8, Cyan);
			LCD_DrawLine(8+5+j*8, 1+36+i*8, 8+5+j*8, 36+7+i*8, Cyan);
				
			Power_Pills--;		
	}
}